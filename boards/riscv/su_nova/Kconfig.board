## boards/riscv/su_nova/su_nova_defconfig
```kconfig
CONFIG_SOC_SU_HYDRA=y
CONFIG_BOARD_SU_NOVA=y
CONFIG_CONSOLE=y
CONFIG_SERIAL=y
CONFIG_UART_CONSOLE=y
CONFIG_XIP=n
CONFIG_CLOCK_CONTROL=y
```

## soc/riscv/su_hydra/Kconfig.soc
```kconfig
config SOC_SU_HYDRA
    bool "su-hydra"
    select 64BIT
    select RISCV
    select RISCV_ISA_RV64I
    select RISCV_ISA_EXT_G
    select RISCV_ISA_EXT_C
```
